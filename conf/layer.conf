## conf/layer.conf
```bitbake
# We have a conf and classes directory, add to BBPATH
BBPATH .= ":${LAYERDIR}"

# We have recipes-* directories, add to BBFILES
BBFILES += "${LAYERDIR}/recipes-*/*/*.bb \
            ${LAYERDIR}/recipes-*/*/*.bbappend"

BBFILE_COLLECTIONS += "meta-ollama-cpp"
BBFILE_PATTERN_meta-ollama-cpp = "^${LAYERDIR}/"
BBFILE_PRIORITY_meta-ollama-cpp = "6"

LAYERDEPENDS_meta-ollama-cpp = "core openembedded-layer meta-python"
LAYERSERIES_COMPAT_meta-ollama-cpp = "walnascar scarthgap nanbield mickledore kirkstone"

# Layer version
LAYERVERSION_meta-ollama-cpp = "1"

# Additional license directories
LICENSE_PATH += "${LAYERDIR}/licenses"
```
